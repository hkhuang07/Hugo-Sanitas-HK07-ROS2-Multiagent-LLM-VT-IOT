## source/robotics/firmware/esp32-s3-main/sdkconfig.defaults
```kconfig
# HK-07 ESP32-S3 SDK Config Defaults
# These are applied before user's sdkconfig

# Target chip
CONFIG_IDF_TARGET="esp32s3"

# Partition table
CONFIG_PARTITION_TABLE_CUSTOM=y
CONFIG_PARTITION_TABLE_CUSTOM_FILENAME="partitions.csv"

# OTA
CONFIG_BOOTLOADER_APP_ROLLBACK_ENABLE=y
CONFIG_ESP_HTTPS_OTA_ALLOW_HTTP=y

# WiFi
CONFIG_ESP_WIFI_SOFTAP_SUPPORT=n
CONFIG_ESP32_WIFI_STATIC_RX_BUFFER_NUM=10
CONFIG_ESP32_WIFI_DYNAMIC_RX_BUFFER_NUM=32

# FreeRTOS
CONFIG_FREERTOS_UNICORE=n
CONFIG_FREERTOS_HZ=1000

# CAN / TWAI
CONFIG_TWAI_ISR_IN_IRAM=y

# SNTP
CONFIG_LWIP_SNTP_MAX_SERVERS=3
CONFIG_LWIP_SNTP_UPDATE_DELAY=60000

# Logging
CONFIG_LOG_DEFAULT_LEVEL_INFO=y

# Stack sizes
CONFIG_ESP_MAIN_TASK_STACK_SIZE=8192
```
